## code/linux-4.19/net/prip/Kconfig
```kconfig
#
# PRIP
##

config PRIP
    bool "Parallel Redundancy Internet Protocol"
    depends on PROC_FS
    default y
    ---help---
        Parallel Redundancy Internet Protocol.
```
